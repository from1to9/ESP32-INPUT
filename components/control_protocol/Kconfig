## components/control_protocol/Kconfig
```kconfig
menu "Control protocol"
    config CONTROL_MOTION_WINDOW_MAX
        int "Maximum negotiated browser motion commands"
        range 1 5 if IDF_TARGET_ESP32S31
        range 1 3 if IDF_TARGET_ESP32C3
        range 1 4
        default 3 if IDF_TARGET_ESP32S31 || IDF_TARGET_ESP32C3
        default 1
        help
            Maximum number of outstanding relative movement commands on a
            negotiated browser WebSocket. A maximum of one preserves the
            target's legacy channel without advertising the motion window.
            The adapter's active-request capacity must support the selected maximum.
endmenu
```

## passport/main/Kconfig.projbuild
```kconfig
menu "Passport diagnostics"
    config PASSPORT_DIAGNOSTICS
        bool "Log bounded heap, input and BLE diagnostics"
        default n
        help
            Log startup internal heap and, for 180 seconds after the UI starts,
            ADC ranges, backlight transitions, button events and LVGL update times.
            BLE transition logging runs for 180 seconds after BLE startup and
            each advertising window plus ten seconds. NVS failure codes are
            logged before the failed store becomes unavailable. This
            does not change button thresholds, event admission or Lock behavior.
            Use only for device diagnosis; serial logging and additional ADC
            reads affect timing. No credentials or peer identities are logged.
endmenu
```
