## firmware/main/Kconfig.projbuild
```kconfig
menu "Input device board resources"

    config APP_TOUCH_LATENCY_DIAGNOSTICS
        bool "Observe one real local Bluetooth touchpad movement window"
        default n
        help
            The first eligible moving pad gesture after Bluetooth HID is ready
            starts one 20 second aggregate capture. Boot, menus, stationary
            touches and release recovery cannot consume it. No input timing or
            permission is changed. Fixed memory records scan/queue/merge and
            Bluetooth submission/completion timing; the existing health log
            prints the frozen summary once. Completion is not host receipt.

    config APP_LOCAL_SPEAKER_TEST
        bool "One bounded local speaker tone before media startup"
        default n
        help
            Diagnostic image only: boot once plays three seconds of local
            1 kHz mono PCM through the actual board codec, without USB audio
            input or microphone capture. A physical button/lock skips or
            cancels the tone. The normal media owner starts only after the
            test confirms codec shutdown. No settings are persisted and no
            public remote audio-test API is enabled by this option.

    config APP_A2DP_ACL_DIAGNOSTICS
        bool "Observe one A2DP playback at Bluetooth receive boundaries"
        depends on IDF_TARGET_ESP32S31 && BT_CLASSIC_ENABLED && BT_A2DP_ENABLE && !BT_A2DP_USE_EXTERNAL_CODEC && BT_CTRL_BR_EDR_MAX_ACL_CONN = 1
        default n
        help
            Starting the first A2DP speaker grant opens a header-only diagnostic
            window of up to 180 seconds. The normal audio diagnostic summary
            reports aggregate HCI fragments, queue timing and RTP sequence gaps.
            No media, keys or device addresses are collected.

    config APP_IMU_CAPTURE
        bool "Bounded raw IMU diagnostic capture"
        default n
        help
            Observe accepted ordered board samples in a fixed PSRAM buffer.
            A Mouse Motion rising edge begins a capture; disabling Motion or
            filling 6000 records ends it. Records are formatted and dumped
            later through the existing diagnostic console, at most one per
            coordinator loop. The observer never changes motion policy or
            reads the sensor. Full storage stops capture, not mouse input.
            This is a diagnostic build option, not a new motion estimator.

    config APP_DISPLAY_SPI_QUEUE_DEPTH
        int "Mosaico display SPI transaction queue ceiling"
        range 1 2
        default 1
        help
            Limit queued transactions for the Mosaico CO5300 panel only.
            The pinned BSP uses PSRAM draw buffers with internal DMA bounce
            buffers. The bus request remains capped at 4092 bytes, while the
            max-length query consumed by the LCD driver is capped at 2048 bytes
            after descriptor rounding. A ceiling of one retains at most 2048
            payload bytes; two permits 4096, plus allocator metadata. Smaller
            hardware limits still apply. The SDK recycles chunks while sending
            the entire viewport and preserves TE and final completion semantics.
            Increasing this ceiling requires a complete internal/DMA memory
            budget and device throughput qualification.

endmenu
```
